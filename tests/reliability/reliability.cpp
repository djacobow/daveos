#include <cstring>
#include <fstream>

#include "boot/control.h"
#include "boot/journal.h"
#include "core/schedule/application.hpp"
#include "core/schedule/wait.hpp"
#include "flash.hpp"
#include "support.hpp"
#include "update/engine.h"
#include "update/module.hpp"
#include "util/boot_version_stamp.h"
#include "util/crc32.h"
#include "util/fault.h"
#include "util/version_stamp.h"
#include "util/wire.h"
#include "watchdog/confirmation.h"
#include "watchdog/watchdog.hpp"

namespace crc = daveos::util::crc32;
namespace wd = daveos::watchdog;
namespace core = daveos::core;
namespace boot = daveos::boot;
namespace update = daveos::update;

static std::vector<std::byte> ReadFile(const char* path) {
  std::ifstream file(path, std::ios::binary | std::ios::ate);
  REQUIRE(file.good());
  std::vector<std::byte> bytes(static_cast<std::size_t>(file.tellg()));
  file.seekg(0);
  file.read(reinterpret_cast<char*>(bytes.data()), bytes.size());
  REQUIRE(file.good());
  return bytes;
}

TEST_CASE("Python factory metadata matches the bootloader journal format") {
  auto bytes = ReadFile(FACTORY_METADATA);
  REQUIRE(bytes.size() == boot::kRecordSize);
  boot::Record record;
  std::copy(bytes.begin(), bytes.end(), record.begin());
  boot::Snapshot snapshot;
  REQUIRE(boot::decode(record, snapshot));
  REQUIRE(snapshot.sequence == 1);
  REQUIRE(snapshot.counter == 1);
  const auto& image = snapshot.images[0];
  REQUIRE(image.state == boot::ImageState::confirmed);
  REQUIRE(image.installation == 1);
  REQUIRE(image.size == 997);
  REQUIRE(image.product == 1);
  REQUIRE(image.revision == 1);
  REQUIRE(image.version.major == 2);
  REQUIRE(image.version.minor == 3);
  REQUIRE(image.version.build == UINT32_MAX);
  REQUIRE(std::string_view(image.version.commit) == "abc123");
  REQUIRE(image.version.dirty);
  REQUIRE(snapshot.images[1].state == boot::ImageState::empty);
  REQUIRE(snapshot.images[1].installation == 0);
  REQUIRE(boot::encode(snapshot) == record);
  auto package = ReadFile(REFERENCE_PACKAGE);
  REQUIRE(image.crc == daveos::util::wire::read32(package, 32));
}

TEST_CASE("CRC matches ISO-HDLC and incremental boundaries") {
  constexpr std::string_view text = "123456789";
  auto bytes = std::as_bytes(std::span(text.data(), text.size()));
  REQUIRE(crc::calculate(bytes) == 0xcbf43926);
  REQUIRE(crc::calculate({}) == 0);
  for (std::size_t cut = 0; cut <= bytes.size(); ++cut) {
    REQUIRE(crc::update(crc::calculate(bytes.first(cut)), bytes.subspan(cut)) ==
            crc::calculate(bytes));
  }
  // Reference generated by Python binascii, including embedded zero/high bits.
  std::array<std::byte, 256> values{};
  for (std::size_t i = 0; i < values.size(); ++i) {
    values[i] = static_cast<std::byte>(i);
  }
  REQUIRE(crc::calculate(values) == 0x29058c73);
  std::uint32_t a = 0, b = 0;
  for (std::size_t i = 0; i < values.size(); ++i) {
    a = crc::update(a, std::span(values).subspan(i, 1));
    b = crc::update(b, bytes);
  }
  REQUIRE(a == 0x29058c73);
  REQUIRE(b != a);
}

TEST_CASE("CRC ISR fallback never calls a shared peripheral") {
  struct Hardware {
    bool interrupt = false;
    unsigned calls = 0;
  } hardware;

  crc::Service service(
      {&hardware,
       [](void* p, std::uint32_t value, std::span<const std::byte> bytes) {
         ++static_cast<Hardware*>(p)->calls;
         return crc::update(value, bytes);
       },
       [](void* p) { return static_cast<Hardware*>(p)->interrupt; }});
  const std::array bytes{std::byte{0x42}, std::byte{0xff}, std::byte{0}};
  auto first = service.calculate(bytes);
  hardware.interrupt = true;
  REQUIRE(service.calculate(bytes) == first);
  REQUIRE(hardware.calls == 1);
  REQUIRE(service.update(first, {}) == first);
}

TEST_CASE("Version stamp carries reproducible diagnostic fields") {
  REQUIRE(daveos::build::kApplicationVersion.major == 0);
  REQUIRE(daveos::build::kApplicationVersion.build == TEST_VERSION_BUILD);
  REQUIRE(daveos::build::kBootloaderVersion.build == TEST_VERSION_BUILD);
  REQUIRE(daveos::build::kBootloaderVersion.major == TEST_BOOT_MAJOR);
  REQUIRE(daveos::build::kBootloaderVersion.minor == TEST_BOOT_MINOR);
  REQUIRE(std::string_view(daveos::build::kApplicationVersion.commit) ==
          daveos::build::kBootloaderVersion.commit);
  REQUIRE(std::strlen(daveos::build::kApplicationVersion.commit) > 0);
}

TEST_CASE(
    "Watchdog checks before start and latches check and driver failures") {
  struct Fixture {
    unsigned starts = 0, feeds = 0, failures = 0;
    core::Status healthy = core::Status::ok;
    core::Status driver = core::Status::ok;
  } fixture;

  wd::Driver driver{&fixture,
                    [](void* p, core::Time timeout) {
                      auto& f = *static_cast<Fixture*>(p);
                      CHECK(timeout == 5000000);
                      ++f.starts;
                      return f.driver;
                    },
                    [](void* p) {
                      auto& f = *static_cast<Fixture*>(p);
                      ++f.feeds;
                      return f.driver;
                    }};
  std::array checks{wd::Check{
      "application", &fixture,
      [](void* p) { return wd::Failure{static_cast<Fixture*>(p)->healthy}; }}};
  wd::Controller controller(driver, checks,
                            {&fixture, [](void* p, const wd::Failure&) {
                               ++static_cast<Fixture*>(p)->failures;
                             }});
  SECTION("pre-start failure never arms hardware") {
    fixture.healthy = core::Status::health_failed;
    REQUIRE(controller.start(std::chrono::seconds{5}) ==
            core::Status::health_failed);
    REQUIRE(fixture.starts == 0);
  }
  SECTION("health failure after startup stops feeds permanently") {
    REQUIRE(controller.start(std::chrono::seconds{5}) == core::Status::ok);
    REQUIRE(fixture.feeds == 0);
    controller.tick();
    REQUIRE(fixture.feeds == 1);
    fixture.healthy = core::Status::health_failed;
    controller.tick();
  }
  SECTION("feed failure latches independently of checks") {
    REQUIRE(controller.start(std::chrono::seconds{5}) == core::Status::ok);
    fixture.driver = core::Status::io_error;
    controller.tick();
    REQUIRE(std::string_view(controller.failure().check) == "feed");
  }
  fixture.healthy = fixture.driver = core::Status::ok;
  auto feeds = fixture.feeds;
  controller.tick();
  REQUIRE(controller.state() == wd::Controller::State::failed);
  REQUIRE(fixture.feeds == feeds);
  REQUIRE(fixture.failures == 1);
  REQUIRE(controller.statistics(wd::Controller::State::failed).entries == 1);
  REQUIRE(controller.statistics(wd::Controller::State::failed).ticks == 1);
  REQUIRE(controller.dwell_count() == 1);
  REQUIRE(controller.start(5000000) != core::Status::ok);
}

TEST_CASE("Progress detects rate deficits with explicit phase and grace") {
  core::Progress<2> progress{true, 1000000, {}};
  progress.tasks[0] = {"fast", "poll", true, 1000, 1000, 899, 1};
  progress.tasks[1] = {"slow", "poll", true, 2000000, 2000000, 0, 1};
  REQUIRE(wd::check_progress(progress, 100000).status == core::Status::ok);
  ++progress.now;
  auto failure = wd::check_progress(progress, 100000);
  REQUIRE(failure.status == core::Status::health_failed);
  REQUIRE(failure.expected == 900);
  REQUIRE(failure.completed == 899);
  progress.tasks[0].repeating = false;
  REQUIRE(wd::check_progress(progress, 100000).status == core::Status::ok);
  progress.now = 2100001;
  REQUIRE(wd::check_progress(progress, 100000).status ==
          core::Status::health_failed);
  progress.running = false;
  REQUIRE(wd::check_progress(progress, 100000).status == core::Status::ok);
}

TEST_CASE("Scheduler progress survives stats reset and resets on reschedule") {
  testing::Fake platform;
  testing::TestModule module;
  auto scheduler =
      core::make_scheduler<testing::Event>(platform, core::ModuleList{&module});
  REQUIRE(scheduler.schedule(module, &testing::TestModule::first, 10,
                             core::Mode::repeat) == core::Status::ok);
  unsigned calls = 0;
  module.first_action = [&] {
    auto before = scheduler.progress();
    REQUIRE(before.tasks[0].completed == calls);
    scheduler.reset_statistics();
    REQUIRE(scheduler.progress().tasks[0].completed == calls);
    ++calls;
    if (calls == 3) {
      auto generation = before.tasks[0].generation;
      REQUIRE(scheduler.schedule(module, &testing::TestModule::first, 20,
                                 core::Mode::repeat) == core::Status::ok);
      auto after = scheduler.progress();
      REQUIRE(after.tasks[0].generation == generation + 1);
      REQUIRE(after.tasks[0].completed == 0);
      REQUIRE(after.tasks[0].first_due == platform.now() + 20);
      scheduler.stop();
    }
  };
  REQUIRE(scheduler.run() == core::Status::ok);
  // Completion of the old invocation must not be credited to its new schedule.
  REQUIRE(scheduler.progress().tasks[0].completed == 0);
}

TEST_CASE("Journal requires a committed CRC-valid snapshot") {
  reliability::MemoryFlash memory;
  boot::Journal journal(memory.driver(), memory.layout());
  boot::Snapshot state;
  REQUIRE(journal.load(state) == core::Status::not_found);
  REQUIRE(journal.commit(state) == core::Status::not_found);
  state.counter = 1;
  REQUIRE(journal.commit(state, 1000000, true) == core::Status::ok);
  REQUIRE(journal.load(state) == core::Status::ok);
  REQUIRE(state.sequence == 1);
  auto record = boot::encode(state);
  for (std::size_t i = 0; i < record.size(); ++i) {
    auto corrupt = record;
    corrupt[i] ^= std::byte{1};
    boot::Snapshot ignored;
    REQUIRE_FALSE(boot::decode(corrupt, ignored));
  }
}

TEST_CASE("Power loss at every journal operation preserves a committed state") {
  reliability::MemoryFlash baseline;
  boot::Journal setup(baseline.driver(), baseline.layout());
  boot::Snapshot original;
  original.counter = 1;
  REQUIRE(setup.commit(original, 1000000, true) == core::Status::ok);
  original.counter = 2;
  REQUIRE(setup.commit(original) == core::Status::ok);
  // Both records in metadata A are full: the next commit reclaims metadata B.
  for (int fail = 0; fail < 17; ++fail) {
    for (auto partial : {0u, 1u, 8u, 15u, 16u, 256u, 512u}) {
      auto memory = baseline;
      memory.fail_operation = memory.operations + fail;
      memory.partial = partial;
      boot::Journal writer(memory.driver(), memory.layout());
      auto next = original;
      next.counter = 3;
      REQUIRE(writer.commit(next) != core::Status::ok);
      boot::Journal reboot(memory.driver(), memory.layout());
      boot::Snapshot recovered;
      REQUIRE(reboot.load(recovered) == core::Status::ok);
      REQUIRE((recovered.counter == 2 || recovered.counter == 3));
      REQUIRE(recovered.sequence == recovered.counter);
      memory.fail_operation = -1;
      next.counter = recovered.counter + 1;
      REQUIRE(reboot.commit(next) == core::Status::ok);
      REQUIRE(reboot.load(recovered) == core::Status::ok);
      REQUIRE(recovered.counter == next.counter);
    }
  }
}

TEST_CASE(
    "Boot selection uses installation order, verifies CRC and consumes "
    "trials") {
  reliability::MemoryFlash memory;
  auto layout = memory.layout();
  boot::Snapshot state;
  state.counter = 2;
  for (std::size_t i = 0; i < 2; ++i) {
    auto bytes = std::span(memory.bytes).subspan(layout.slots[i], 128);
    std::fill(bytes.begin(), bytes.end(), std::byte(0x11 + i));
    state.images[i] = {i + 1,
                       128,
                       crc::calculate(bytes),
                       boot::ImageState::confirmed,
                       layout.product,
                       layout.revision};
  }
  state.images[0].version.major = 99;
  state.images[1].version.major = 1;
  boot::Journal journal(memory.driver(), layout);
  SECTION("new installation wins despite lower version") {
    REQUIRE(journal.commit(state, 1000000, true) == core::Status::ok);
    boot::Control control(memory.driver(), layout);
    REQUIRE(control.select().slot == 1);
    auto operations = memory.operations;
    REQUIRE(control.confirm_image(1) == core::Status::ok);
    REQUIRE(memory.operations == operations);
  }
  SECTION("corrupted confirmed image cannot boot") {
    REQUIRE(journal.commit(state, 1000000, true) == core::Status::ok);
    memory.bytes[layout.slots[1] + 17] ^= std::byte{1};
    boot::Control control(memory.driver(), layout);
    REQUIRE(control.select().slot == 0);
    memory.bytes[layout.slots[0] + 17] ^= std::byte{1};
    REQUIRE(control.select().status == core::Status::checksum_error);
  }
  SECTION("reset after starting a trial rejects it permanently") {
    state.images[1].state = boot::ImageState::pending;
    REQUIRE(journal.commit(state, 1000000, true) == core::Status::ok);
    boot::Control control(memory.driver(), layout);
    auto first = control.select();
    REQUIRE(first.slot == 1);
    REQUIRE(first.trial);
    boot::Control reboot(memory.driver(), layout);
    REQUIRE(reboot.select().slot == 0);
    REQUIRE(reboot.select().slot == 0);
    REQUIRE(journal.load(state) == core::Status::ok);
    REQUIRE(state.images[1].state == boot::ImageState::rejected);
  }
  SECTION("confirmed trial remains bootable after reset") {
    state.images[1].state = boot::ImageState::pending;
    REQUIRE(journal.commit(state, 1000000, true) == core::Status::ok);
    boot::Control control(memory.driver(), layout);
    REQUIRE(control.select().slot == 1);
    REQUIRE(control.confirm_image(1) == core::Status::ok);
    boot::Control reboot(memory.driver(), layout);
    REQUIRE(reboot.select().slot == 1);
  }
}

TEST_CASE("Retained faults validate every byte and survive image-local data") {
  namespace fault = daveos::util::fault;
  fault::Record record{};
  fault::Data recovered;
  REQUIRE_FALSE(fault::read(record, recovered));
  fault::Data data;
  data.kind = fault::Kind::watchdog;
  data.installation = 123;
  data.frame_valid = true;
  data.frame[6] = 0x8012345;
  fault::copy_name(data.module,
                   "module whose name is deliberately much too long");
  fault::save(record, data);
  REQUIRE(fault::read(record, recovered));
  REQUIRE(recovered.installation == 123);
  REQUIRE(recovered.frame[6] == 0x8012345);
  REQUIRE(std::strlen(recovered.module) == 31);
  for (std::size_t i = 0; i < record.bytes.size(); ++i) {
    auto corrupt = record;
    corrupt.bytes[i] ^= std::byte{1};
    REQUIRE_FALSE(fault::read(corrupt, recovered));
  }
  fault::clear(record);
  REQUIRE_FALSE(fault::read(record, recovered));
}

TEST_CASE(
    "OTA streams independent Python package through bounded flash operations") {
  const auto package = ReadFile(REFERENCE_PACKAGE);
  const auto expected = ReadFile(REFERENCE_IMAGE);
  const auto chunk_size = GENERATE(1u, 7u, 63u, 1024u);
  reliability::MemoryFlash memory;
  auto layout = memory.layout();
  boot::Snapshot factory;
  factory.counter = 1;
  factory.images[0] = {1, 16, 0, boot::ImageState::confirmed, 1, 1};
  boot::Journal journal(memory.driver(), layout);
  REQUIRE(journal.commit(factory, 1000000, true) == core::Status::ok);
  update::Engine engine(memory.driver(), layout, 0);
  const auto header = std::span(package).first(update::kHeaderSize);
  const auto payload = std::span(package).subspan(update::kHeaderSize);
  REQUIRE(engine.begin(header) == core::Status::not_running);
  engine.enable(true);
  REQUIRE(engine.begin(header) == core::Status::ok);
  bool checked_bad_crc = false;
  for (unsigned ticks = 0; ticks < 20000 && engine.active(); ++ticks) {
    engine.tick();
    if (engine.ready()) {
      auto offset = engine.next_offset();
      auto bytes = payload.subspan(
          offset, std::min<std::size_t>(chunk_size, payload.size() - offset));
      if (!checked_bad_crc) {
        REQUIRE(engine.chunk(offset, bytes, crc::calculate(bytes) ^ 1) ==
                core::Status::checksum_error);
        REQUIRE(engine.next_offset() == offset);
        checked_bad_crc = true;
      }
      REQUIRE(engine.chunk(offset, bytes, crc::calculate(bytes)) ==
              core::Status::ok);
    }
  }
  REQUIRE(engine.state() == update::Engine::State::done);
  REQUIRE(engine.dwell_count() == 0);
  REQUIRE(engine.statistics(update::Engine::State::disabled).entries == 1);
  REQUIRE(engine.statistics(update::Engine::State::done).entries == 1);
  REQUIRE(engine.statistics(update::Engine::State::done).ticks == 0);
  REQUIRE(engine.statistics(update::Engine::State::writing).ticks > 0);
  REQUIRE(engine.statistics(update::Engine::State::verifying).ticks > 0);
  REQUIRE(engine.status() == core::Status::ok);
  REQUIRE(std::equal(expected.begin(), expected.end(),
                     memory.bytes.begin() + layout.slots[1]));
  // Three trailing pad bytes are erased, not part of the image CRC.
  REQUIRE(memory.bytes[layout.slots[1] + expected.size()] == std::byte{0xff});
  REQUIRE(journal.load(factory) == core::Status::ok);
  REQUIRE(factory.counter == 2);
  REQUIRE(factory.images[1].state == boot::ImageState::pending);
  REQUIRE(factory.images[1].crc == crc::calculate(expected));
  // Repeat uploads can replace a completed candidate without reboot.
  REQUIRE(engine.begin(header) == core::Status::ok);
  for (unsigned ticks = 0; ticks < 20000 && engine.active(); ++ticks) {
    engine.tick();
    if (engine.ready()) {
      auto offset = engine.next_offset();
      auto bytes = payload.subspan(
          offset, std::min<std::size_t>(1024, payload.size() - offset));
      REQUIRE(engine.chunk(offset, bytes, crc::calculate(bytes)) ==
              core::Status::ok);
    }
  }
  REQUIRE(engine.status() == core::Status::ok);
  REQUIRE(journal.load(factory) == core::Status::ok);
  REQUIRE(factory.counter == 3);
  REQUIRE(engine.statistics(update::Engine::State::done).entries == 2);
  REQUIRE(engine.statistics(update::Engine::State::done).ticks == 1);
}

namespace {
  std::array<std::byte, 88> Exchange(update::Protocol& protocol,
                                     update::Engine& engine,
                                     std::uint32_t operation,
                                     std::span<const std::byte> payload,
                                     std::size_t fragment) {
    std::vector<std::byte> frame(16 + payload.size());
    daveos::util::wire::write32(frame, 0, update::kProtocolMagic);
    daveos::util::wire::write32(frame, 4, 1);
    daveos::util::wire::write32(frame, 8, operation);
    daveos::util::wire::write32(frame, 12, payload.size());
    std::copy(payload.begin(), payload.end(), frame.begin() + 16);
    std::size_t at = 0;
    for (unsigned i = 0; i < 10000 && protocol.reply().empty(); ++i) {
      engine.tick();
      at += protocol.tick(
          std::span(frame).subspan(at, std::min(fragment, frame.size() - at)));
    }
    REQUIRE(at == frame.size());
    REQUIRE(protocol.reply().size() == 88);
    std::array<std::byte, 88> result;
    std::copy(protocol.reply().begin(), protocol.reply().end(), result.begin());
    REQUIRE(daveos::util::wire::read32(result, 8) == (operation | 0x80000000));
    protocol.sent();
    protocol.tick();
    REQUIRE(protocol.reply().empty());
    return result;
  }
}  // namespace

TEST_CASE(
    "OTA protocol tolerates fragmentation and queues reboot only after "
    "commit") {
  const auto fragment = GENERATE(1u, 5u, 1048u);
  const auto package = ReadFile(REFERENCE_PACKAGE);
  reliability::MemoryFlash memory;
  boot::Snapshot initial;
  initial.counter = 1;
  initial.images[0] = {1, 16, 0, boot::ImageState::confirmed, 1, 1};
  boot::Journal journal(memory.driver(), memory.layout());
  REQUIRE(journal.commit(initial, 1000000, true) == core::Status::ok);
  update::Engine engine(memory.driver(), memory.layout(), 2);
  REQUIRE(engine.running_slot(0) == core::Status::ok);
  bool reboot = false;
  update::Protocol protocol(engine, {&reboot, [](void* p) {
                                       *static_cast<bool*>(p) = true;
                                       return core::Status::ok;
                                     }});
  auto result =
      Exchange(protocol, engine, 1, std::span(package).first(128), fragment);
  REQUIRE(daveos::util::wire::read32(result, 16) ==
          static_cast<std::uint32_t>(core::Status::not_running));
  engine.enable(true);
  REQUIRE(engine.running_slot(1) == core::Status::busy);
  result = Exchange(protocol, engine, 5, {}, fragment);
  REQUIRE_FALSE(reboot);
  result =
      Exchange(protocol, engine, 1, std::span(package).first(128), fragment);
  REQUIRE(daveos::util::wire::read32(result, 16) == 0);
  for (unsigned i = 0; i < 20000 && engine.active(); ++i) {
    engine.tick();
    if (engine.ready()) {
      auto at = engine.next_offset();
      auto data = std::span(package).subspan(128 + at);
      std::vector<std::byte> payload(8 + data.size());
      daveos::util::wire::write32(payload, 0, at);
      daveos::util::wire::write32(payload, 4, crc::calculate(data));
      std::copy(data.begin(), data.end(), payload.begin() + 8);
      result = Exchange(protocol, engine, 3, payload, fragment);
      REQUIRE(daveos::util::wire::read32(result, 16) == 0);
    }
  }
  REQUIRE(engine.state() == update::Engine::State::done);
  REQUIRE(journal.load(initial) == core::Status::ok);
  REQUIRE(initial.images[1].state == boot::ImageState::pending);
  result = Exchange(protocol, engine, 5, {}, fragment);
  REQUIRE(daveos::util::wire::read32(result, 16) == 0);
  REQUIRE(reboot);
}

TEST_CASE("OTA module initializes identity before accepting commands") {
  reliability::MemoryFlash memory;
  update::Engine engine(memory.driver(), memory.layout(), 2);
  update::Module<testing::Event> module(engine);
  module.setup(&engine, [](void* p) {
    return static_cast<update::Engine*>(p)->running_slot(0);
  });
  testing::Fake platform;
  core::CommandSource source;
  auto app = core::make_application<testing::Event>(
      platform, core::ModuleList{&module}, core::CommandSourceList{source});
  REQUIRE_FALSE(engine.enabled());
  REQUIRE(app.init() == core::Status::ok);
  REQUIRE(source.dispatch("ota enable") == core::Status::not_running);
  std::function<void()> exercise = [&] {
    REQUIRE(source.dispatch("ota enable") == core::Status::ok);
    REQUIRE(engine.enabled());
    REQUIRE(source.dispatch("ota status") == core::Status::ok);
    REQUIRE(source.dispatch("ota disable") == core::Status::ok);
    REQUIRE_FALSE(engine.enabled());
    REQUIRE(module.scheduler().stop() == core::Status::ok);
  };
  module.transport(
      &exercise, [](void* p) { (*static_cast<std::function<void()>*>(p))(); });
  REQUIRE(app.run() == core::Status::ok);
}

TEST_CASE("OTA invalidates a candidate when the final commit reports failure") {
  auto package = ReadFile(REFERENCE_PACKAGE);
  reliability::MemoryFlash memory;
  boot::Snapshot initial;
  initial.counter = 1;
  initial.images[0] = {1, 16, 0, boot::ImageState::confirmed, 1, 1};
  boot::Journal journal(memory.driver(), memory.layout());
  REQUIRE(journal.commit(initial, 1000000, true) == core::Status::ok);
  update::Engine engine(memory.driver(), memory.layout(), 0);
  engine.enable(true);
  REQUIRE(engine.begin(std::span(package).first(128)) == core::Status::ok);
  bool injected = false;
  for (unsigned i = 0; i < 20000 && engine.active(); ++i) {
    if (!injected && engine.state() == update::Engine::State::committing &&
        memory.pending && !memory.pending->erase &&
        memory.pending->address % 256 == 240) {
      // All commit bytes reach flash, but the driver still reports an error.
      // The failed transaction must not leave a bootable pending image behind.
      memory.fail_operation = memory.operations;
      memory.partial = 16;
      injected = true;
    }
    engine.tick();
    if (engine.ready()) {
      auto data = std::span(package).subspan(128 + engine.next_offset());
      REQUIRE(engine.chunk(engine.next_offset(), data, crc::calculate(data)) ==
              core::Status::ok);
    }
  }
  REQUIRE(injected);
  REQUIRE(engine.state() == update::Engine::State::failed);
  REQUIRE(engine.status() == core::Status::io_error);
  REQUIRE(journal.load(initial) == core::Status::ok);
  REQUIRE(initial.images[1].state == boot::ImageState::incomplete);
  REQUIRE(initial.images[0].state == boot::ImageState::confirmed);
}

TEST_CASE(
    "Trial confirmation requires a continuous healthy interval and never "
    "retries") {
  struct Result {
    unsigned calls = 0;
    core::Status status = core::Status::ok;
  } result;

  wd::Confirmation confirmation(std::chrono::seconds{5});
  confirmation.callback(&result, [](void* p) {
    auto& value = *static_cast<Result*>(p);
    ++value.calls;
    return value.status;
  });
  REQUIRE(confirmation.tick(100000, true) == core::Status::ok);
  REQUIRE(confirmation.statistics(wd::Confirmation::State::waiting).ticks == 1);
  REQUIRE(confirmation.statistics(wd::Confirmation::State::observing).entries ==
          1);
  REQUIRE(confirmation.dwell_count() == 0);
  REQUIRE(confirmation.tick(5099999, true) == core::Status::ok);
  REQUIRE(result.calls == 0);
  SECTION("confirms at boundary exactly once") {
    REQUIRE(confirmation.tick(5100000, true) == core::Status::ok);
    REQUIRE(result.calls == 1);
    REQUIRE(confirmation.state() == wd::Confirmation::State::confirmed);
    confirmation.tick(20000000, true);
    REQUIRE(result.calls == 1);
  }
  SECTION("recovered health cannot revive a failed trial gate") {
    REQUIRE(confirmation.tick(5100000, false) == core::Status::health_failed);
    REQUIRE(confirmation.tick(20000000, true) == core::Status::health_failed);
    REQUIRE(result.calls == 0);
  }
  SECTION("durable confirmation failure is terminal") {
    result.status = core::Status::io_error;
    REQUIRE(confirmation.tick(5100000, true) == core::Status::io_error);
    result.status = core::Status::ok;
    REQUIRE(confirmation.tick(20000000, true) == core::Status::io_error);
    REQUIRE(result.calls == 1);
  }
}

TEST_CASE(
    "OTA cancellation at every flash phase leaves no bootable candidate") {
  using State = update::Engine::State;
  const auto phase =
      GENERATE(State::invalidating, State::receiving, State::writing,
               State::verifying, State::committing);
  const auto disable = GENERATE(false, true);
  const auto package = ReadFile(REFERENCE_PACKAGE);
  reliability::MemoryFlash memory;
  boot::Snapshot initial;
  initial.counter = 1;
  initial.images[0] = {1, 16, 0, boot::ImageState::confirmed, 1, 1};
  boot::Journal journal(memory.driver(), memory.layout());
  REQUIRE(journal.commit(initial, 1000000, true) == core::Status::ok);
  update::Engine engine(memory.driver(), memory.layout(), 0);
  engine.enable(true);
  REQUIRE(engine.begin(std::span(package).first(128)) == core::Status::ok);
  bool injected = false;
  for (std::uint32_t i = 0; i < 20000 && engine.active(); ++i) {
    if (!injected && engine.state() == phase) {
      // Hit outstanding erase/program writes, including the commit marker.
      if ((phase == State::writing && !memory.pending) ||
          (phase == State::committing &&
           (!memory.pending || memory.pending->erase ||
            memory.pending->address % 256 != 240))) {
        engine.tick();
        continue;
      }
      if (disable) {
        engine.enable(false);
      } else {
        engine.abort();
      }
      injected = true;
    }
    engine.tick();
    if (!injected && engine.ready()) {
      auto data = std::span(package).subspan(128 + engine.next_offset());
      REQUIRE(engine.chunk(engine.next_offset(), data, crc::calculate(data)) ==
              core::Status::ok);
    }
  }
  REQUIRE(injected);
  REQUIRE_FALSE(engine.active());
  REQUIRE_FALSE(memory.pending);
  REQUIRE(journal.load(initial) == core::Status::ok);
  REQUIRE(initial.images[0].state == boot::ImageState::confirmed);
  REQUIRE(initial.images[1].state == boot::ImageState::incomplete);
  engine.enable(true);
  REQUIRE(engine.begin(std::span(package).first(128)) == core::Status::ok);
  REQUIRE(engine.next_offset() == 0);
}

TEST_CASE(
    "H755 journal commits 32-byte trailers and checkpoints before runtime "
    "erase") {
  for (auto executing : {0u, 1u}) {
    reliability::MemoryFlash flash;
    flash.write_size = 32;
    auto layout = flash.layout();
    layout.write_size = 32;
    REQUIRE(layout.valid());
    boot::Snapshot initial;
    initial.counter = 1;
    boot::Journal factory(flash.driver(), layout);
    REQUIRE(factory.commit(initial, 1000000, true) == core::Status::ok);
    flash.executing = executing;
    boot::Journal journal(flash.driver(), layout);
    boot::Snapshot snapshot;
    REQUIRE(journal.load(snapshot) == core::Status::ok);
    // One sector has only two records, forcing checkpoint/reclamation quickly.
    for (std::uint32_t i = 0; i < 2 - executing; ++i) {
      ++snapshot.counter;
      REQUIRE(journal.commit(snapshot) == core::Status::ok);
    }
    auto before = flash;
    before.erases.clear();
    ++snapshot.counter;
    auto complete = before;
    boot::Journal successful(complete.driver(), layout);
    REQUIRE(successful.commit(snapshot) == core::Status::ok);
    REQUIRE(complete.erases ==
            std::vector<std::uint32_t>{layout.metadata[1 - executing]});
    const auto operations = complete.operations - before.operations;
    // Cut each operation, including checkpoint body/trailer, erase, and new
    // body/trailer. Recovery must see the old or fully committed new state.
    for (int cut = 0; cut < operations; ++cut) {
      for (auto partial : {0u, 1u, 15u, 16u, 31u, 32u, 255u, 511u}) {
        auto torn = before;
        torn.fail_operation = torn.operations + cut;
        torn.partial = partial;
        boot::Journal interrupted(torn.driver(), layout);
        REQUIRE(interrupted.commit(snapshot) != core::Status::ok);
        torn.fail_operation = -1;
        boot::Journal reopened(torn.driver(), layout);
        boot::Snapshot recovered;
        REQUIRE(reopened.load(recovered) == core::Status::ok);
        REQUIRE((recovered.counter == snapshot.counter - 1 ||
                 recovered.counter == snapshot.counter));
        for (auto erased : torn.erases) {
          REQUIRE(erased != layout.metadata[executing]);
        }
      }
    }
    boot::Snapshot loaded;
    REQUIRE(successful.load(loaded) == core::Status::ok);
    REQUIRE(loaded.counter == snapshot.counter);
    REQUIRE(daveos::util::wire::read32(boot::encode(loaded, 32), 4) == 2);
    // Eventually the executing-bank checkpoint area is exhausted: fail
    // without changing flash instead of erasing it or rebooting implicitly.
    auto result = core::Status::ok;
    for (int i = 0; i < 10 && result == core::Status::ok; ++i) {
      ++snapshot.counter;
      result = successful.commit(snapshot);
    }
    REQUIRE(result == core::Status::full);
    for (auto erased : complete.erases) {
      REQUIRE(erased != layout.metadata[executing]);
    }
  }
}

TEST_CASE(
    "Boot maintenance restores runtime checkpoint space without losing "
    "metadata") {
  for (auto bank : {0u, 1u}) {
    reliability::MemoryFlash initial;
    initial.write_size = 32;
    auto layout = initial.layout();
    layout.write_size = 32;
    boot::Snapshot snapshot;
    snapshot.counter = 19;
    boot::Journal factory(initial.driver(), layout);
    REQUIRE(factory.commit(snapshot, 1000000, true) == core::Status::ok);
    auto successful = initial;
    boot::Journal maintenance(successful.driver(), layout);
    REQUIRE(maintenance.prepare_runtime(bank) == core::Status::ok);
    REQUIRE(std::all_of(
        successful.bytes.begin() + layout.metadata[bank],
        successful.bytes.begin() + layout.metadata[bank] + layout.sector_size,
        [](auto b) { return b == std::byte{0xff}; }));
    for (int cut = initial.operations; cut < successful.operations; ++cut) {
      for (auto partial : {0u, 16u, 31u, 32u, 511u}) {
        auto flash = initial;
        flash.fail_operation = cut;
        flash.partial = partial;
        boot::Journal interrupted(flash.driver(), layout);
        REQUIRE(interrupted.prepare_runtime(bank) != core::Status::ok);
        flash.fail_operation = -1;
        boot::Snapshot loaded;
        boot::Journal reopened(flash.driver(), layout);
        REQUIRE(reopened.load(loaded) == core::Status::ok);
        REQUIRE(loaded.counter == 19);
        REQUIRE(reopened.prepare_runtime(bank) == core::Status::ok);
        flash.executing = bank;
        REQUIRE(reopened.prepare_runtime(bank) == core::Status::unsupported);
        ++loaded.counter;
        REQUIRE(reopened.commit(loaded) == core::Status::ok);
      }
    }
  }
}

TEST_CASE("watchdog grace covers a suspended yielding task until it returns") {
  testing::Fake platform;
  testing::TestModule module;
  auto scheduler =
      core::make_scheduler<testing::Event>(platform, core::ModuleList{&module});
  bool checked = false;
  module.second_action = [&] {
    const auto progress = scheduler.progress();
    CHECK(progress.tasks[0].completed == 0);
    CHECK(wd::check_progress(progress, 0).status ==
          core::Status::health_failed);
    CHECK(wd::check_progress(progress, 30).status == core::Status::ok);
    checked = true;
  };
  module.first_action = [&] {
    const auto started = platform.now();
    CHECK(core::wait_for_release([&] { return platform.now() - started >= 20; },
                                 [&] {
                                   platform.advance(1);
                                   return scheduler.yield();
                                 },
                                 [&] { return platform.now(); },
                                 std::chrono::microseconds{25}) ==
          core::Status::ok);
    CHECK(checked);
    CHECK(scheduler.progress().tasks[0].completed == 0);
    scheduler.stop();
  };
  REQUIRE(scheduler.schedule(module, &testing::TestModule::first, 10,
                             core::Mode::repeat) == core::Status::ok);
  REQUIRE(scheduler.schedule(module, &testing::TestModule::second, 15) ==
          core::Status::ok);
  REQUIRE(scheduler.run() == core::Status::ok);
  CHECK(scheduler.progress().tasks[0].completed == 1);
}
